## boards/arm/mynrf52811/mynrf52811_defconfig
```kconfig
# Copyright (c) 2022 Nordic Semiconductor ASA
# SPDX-License-Identifier: Apache-2.0

CONFIG_SOC_SERIES_NRF52X=y
CONFIG_SOC_NRF52811_QFAA=y
CONFIG_BOARD_MYNRF52811=y

# Enable MPU
CONFIG_ARM_MPU=y

# Enable hardware stack protection
CONFIG_HW_STACK_PROTECTION=y
```

## build/Kconfig/Kconfig.modules
```kconfig
menu "nrf (C:/Users/Thomas/ncs/v1.9.1/nrf)"
osource "C:/Users/Thomas/ncs/v1.9.1/nrf/Kconfig.nrf"
config ZEPHYR_NRF_MODULE
	bool
	default y
endmenu
menu "mcuboot (C:/Users/Thomas/ncs/v1.9.1/bootloader/mcuboot)"
osource "$(ZEPHYR_MCUBOOT_KCONFIG)"
config ZEPHYR_MCUBOOT_MODULE
	bool
	default y
endmenu
menu "mbedtls (C:/Users/Thomas/ncs/v1.9.1/mbedtls)"
osource "$(ZEPHYR_MBEDTLS_KCONFIG)"
config ZEPHYR_MBEDTLS_MODULE
	bool
	default y
endmenu
menu "trusted-firmware-m (C:/Users/Thomas/ncs/v1.9.1/modules/tee/tf-m/trusted-firmware-m)"
osource "$(ZEPHYR_TRUSTED_FIRMWARE_M_KCONFIG)"
config ZEPHYR_TRUSTED_FIRMWARE_M_MODULE
	bool
	default y
endmenu
menu "cjson (C:/Users/Thomas/ncs/v1.9.1/modules/lib/cjson)"
osource "$(ZEPHYR_CJSON_KCONFIG)"
config ZEPHYR_CJSON_MODULE
	bool
	default y
endmenu
menu "cddl-gen (C:/Users/Thomas/ncs/v1.9.1/modules/lib/cddl-gen)"
osource "$(ZEPHYR_CDDL_GEN_KCONFIG)"
config ZEPHYR_CDDL_GEN_MODULE
	bool
	default y
endmenu
menu "memfault-firmware-sdk (C:/Users/Thomas/ncs/v1.9.1/modules/lib/memfault-firmware-sdk)"
osource "C:/Users/Thomas/ncs/v1.9.1/modules/lib/memfault-firmware-sdk/ports/zephyr/Kconfig"
config ZEPHYR_MEMFAULT_FIRMWARE_SDK_MODULE
	bool
	default y
endmenu
menu "CANopenNode (C:/Users/Thomas/ncs/v1.9.1/modules/lib/canopennode)"
osource "$(ZEPHYR_CANOPENNODE_KCONFIG)"
config ZEPHYR_CANOPENNODE_MODULE
	bool
	default y
endmenu
menu "hal_nordic (C:/Users/Thomas/ncs/v1.9.1/modules/hal/nordic)"
osource "$(ZEPHYR_HAL_NORDIC_KCONFIG)"
config ZEPHYR_HAL_NORDIC_MODULE
	bool
	default y
endmenu
menu "loramac-node (C:/Users/Thomas/ncs/v1.9.1/modules/lib/loramac-node)"
osource "$(ZEPHYR_LORAMAC_NODE_KCONFIG)"
config ZEPHYR_LORAMAC_NODE_MODULE
	bool
	default y
endmenu
menu "lz4 (C:/Users/Thomas/ncs/v1.9.1/modules/lib/lz4)"
osource "$(ZEPHYR_LZ4_KCONFIG)"
config ZEPHYR_LZ4_MODULE
	bool
	default y
endmenu
menu "mbedtls (C:/Users/Thomas/ncs/v1.9.1/modules/crypto/mbedtls)"
osource "$(ZEPHYR_MBEDTLS_KCONFIG)"
config ZEPHYR_MBEDTLS_MODULE
	bool
	default y
endmenu
menu "TraceRecorder (C:/Users/Thomas/ncs/v1.9.1/modules/debug/TraceRecorder)"
osource "C:/Users/Thomas/ncs/v1.9.1/modules/debug/TraceRecorder/kernelports/Zephyr/Kconfig"
config ZEPHYR_TRACERECORDER_MODULE
	bool
	default y
endmenu
menu "zscilib (C:/Users/Thomas/ncs/v1.9.1/modules/lib/zscilib)"
osource "C:/Users/Thomas/ncs/v1.9.1/modules/lib/zscilib/Kconfig.zscilib"
config ZEPHYR_ZSCILIB_MODULE
	bool
	default y
endmenu
menu "nrfxlib (C:/Users/Thomas/ncs/v1.9.1/nrfxlib)"
osource "C:/Users/Thomas/ncs/v1.9.1/nrfxlib/Kconfig.nrfxlib"
config ZEPHYR_NRFXLIB_MODULE
	bool
	default y
endmenu
menu "connectedhomeip (C:/Users/Thomas/ncs/v1.9.1/modules/lib/matter)"
osource "C:/Users/Thomas/ncs/v1.9.1/modules/lib/matter/config/nrfconnect/chip-module/Kconfig"
config ZEPHYR_CONNECTEDHOMEIP_MODULE
	bool
	default y
endmenu
```

## build/Kconfig/Kconfig.shield
```kconfig
osource "d:/Code/Nordic/test3/boards/shields/*/Kconfig.shield"
osource "d:/Code/Nordic/test3/lpuart/boards/shields/*/Kconfig.shield"
osource "d:/Code/Nordic/test3/beacon/boards/shields/*/Kconfig.shield"
osource "d:/Code/Nordic/test3/direction_finding_connectionless_tx/boards/shields/*/Kconfig.shield"
osource "d:/Code/Nordic/test3/direction_finding_locator/boards/shields/*/Kconfig.shield"
osource "d:/Code/Nordic/test3/direction_finding_central/boards/shields/*/Kconfig.shield"
osource "d:/Code/Nordic/test3/peripheral_uart/boards/shields/*/Kconfig.shield"
osource "d:/Code/Nordic/test3/hci_lpuart/boards/shields/*/Kconfig.shield"
osource "d:/Code/Nordic/test3/hci_uart/boards/shields/*/Kconfig.shield"
osource "d:/Code/Nordic/test3/zhpyer_direction_finding_connectionless_rx/boards/shields/*/Kconfig.shield"
osource "d:/Code/Nordic/test3/zhpyer_direction_finding_connectionless_tx/boards/shields/*/Kconfig.shield"
osource "C:/Users/Thomas/ncs/v1.9.1/nrf/boards/shields/*/Kconfig.shield"
```

## build/Kconfig/Kconfig.shield.defconfig
```kconfig
osource "d:/Code/Nordic/test3/boards/shields/*/Kconfig.defconfig"
osource "d:/Code/Nordic/test3/lpuart/boards/shields/*/Kconfig.defconfig"
osource "d:/Code/Nordic/test3/beacon/boards/shields/*/Kconfig.defconfig"
osource "d:/Code/Nordic/test3/direction_finding_connectionless_tx/boards/shields/*/Kconfig.defconfig"
osource "d:/Code/Nordic/test3/direction_finding_locator/boards/shields/*/Kconfig.defconfig"
osource "d:/Code/Nordic/test3/direction_finding_central/boards/shields/*/Kconfig.defconfig"
osource "d:/Code/Nordic/test3/peripheral_uart/boards/shields/*/Kconfig.defconfig"
osource "d:/Code/Nordic/test3/hci_lpuart/boards/shields/*/Kconfig.defconfig"
osource "d:/Code/Nordic/test3/hci_uart/boards/shields/*/Kconfig.defconfig"
osource "d:/Code/Nordic/test3/zhpyer_direction_finding_connectionless_rx/boards/shields/*/Kconfig.defconfig"
osource "d:/Code/Nordic/test3/zhpyer_direction_finding_connectionless_tx/boards/shields/*/Kconfig.defconfig"
osource "C:/Users/Thomas/ncs/v1.9.1/nrf/boards/shields/*/Kconfig.defconfig"
```

## locator/boards/arm/mynrf52811/Kconfig.defconfig
```kconfig
# Copyright (c) 2022 Nordic Semiconductor ASA
# SPDX-License-Identifier: Apache-2.0

if BOARD_MYNRF52811

config BOARD
	default "mynrf52811"

config BT_CTLR
   default BT

endif
```

## locator/boards/arm/mynrf52833/Kconfig.defconfig
```kconfig
# Copyright (c) 2022 Nordic Semiconductor ASA
# SPDX-License-Identifier: Apache-2.0

if BOARD_MYNRF52833

config BOARD
	default "mynrf52833"

config BT_CTLR
   default BT

endif
```

## server/boards/arm/mynrf52811/Kconfig.board
```kconfig
# Copyright (c) 2022 Nordic Semiconductor ASA
# SPDX-License-Identifier: Apache-2.0

config BOARD_MYNRF52811
	bool "mynrf52811"
	depends on SOC_NRF52811_QFAA
```
