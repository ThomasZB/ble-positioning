## CMakeLists.txt
```
# SPDX-License-Identifier: Apache-2.0

cmake_minimum_required(VERSION 3.20.0)

find_package(Zephyr REQUIRED HINTS $ENV{ZEPHYR_BASE})
project(my_test1)

include_directories(inc)
target_sources(app PRIVATE  
    src/main.c
    src/myuart.c
    src/mybluetooth.c)
```

## prj.conf
```kconfig
# 配置文件

# 使能串口
CONFIG_SERIAL=y
CONFIG_NRFX_UARTE0=y
CONFIG_UART_ASYNC_API=y

# 使能蓝牙协议栈和GATT Client
CONFIG_BT=y
CONFIG_BT_CENTRAL=y
CONFIG_BT_GATT_CLIENT=y

# 蓝牙基础配置
CONFIG_BT_DEVICE_NAME="ble_thomas_client"
CONFIG_BT_SCAN=y
CONFIG_BT_GATT_DM=y
CONFIG_BT_SCAN_NAME_CNT=1
CONFIG_BT_SCAN_FILTER_ENABLE=y
# CONFIG_BT_RX_STACK_SIZE=2200

# 蓝牙服务发现
CONFIG_HEAP_MEM_POOL_SIZE=2048

# 蓝牙寻向相关使能
CONFIG_BT_EXT_ADV=y
CONFIG_BT_OBSERVER=y
CONFIG_BT_PER_ADV_SYNC=y

CONFIG_BT_DF=y
CONFIG_BT_DF_CONNECTIONLESS_CTE_RX=y

CONFIG_BT_CTLR=y
CONFIG_BT_LL_SW_SPLIT=y
CONFIG_BT_CTLR_ADV_EXT=y
CONFIG_BT_CTLR_SYNC_PERIODIC=y
CONFIG_BT_CTLR_DF=y
CONFIG_BT_CTLR_DF_SCAN_CTE_RX=y

CONFIG_BT_CTLR_ADV_PERIODIC=n
CONFIG_BT_CTLR_DF_ANT_SWITCH_RX=n
CONFIG_BT_CTLR_DF_ANT_SWITCH_TX=n
CONFIG_BT_CTLR_DF_ADV_CTE_TX=n

CONFIG_BT_DF_CTE_RX_AOA=n
CONFIG_BT_CTLR_ADVANCED_FEATURES=y


# # 通过禁用某些功能、降低某些堆栈大小来降低蓝牙协议栈内存占用
# CONFIG_BT_PHY_UPDATE=n
# CONFIG_BT_BUF_EVT_RX_COUNT=2
# CONFIG_BT_BUF_EVT_DISCARDABLE_COUNT=1
# CONFIG_BT_ASSERT=n
# CONFIG_BT_MAX_PAIRED=1
# CONFIG_BT_L2CAP_TX_BUF_COUNT=2
# CONFIG_BT_GATT_SERVICE_CHANGED=n
# CONFIG_BT_GAP_PERIPHERAL_PREF_PARAMS=n
# CONFIG_BT_CTLR_PRIVACY=n
CONFIG_BT_MAX_CONN=1
# CONFIG_BT_BUF_EVT_RX_SIZE=68
# CONFIG_BT_BUF_CMD_TX_SIZE=65
# CONFIG_BT_CTLR_AD_DATA_BACKUP=n


# # 降低系统内存占用
# CONFIG_DEBUG_THREAD_INFO=y
# CONFIG_DEBUG_OPTIMIZATIONS=y
# CONFIG_SYSTEM_WORKQUEUE_STACK_SIZE=512
# CONFIG_IDLE_STACK_SIZE=128
# CONFIG_ISR_STACK_SIZE=1024
# CONFIG_TIMESLICING=n

# # 提高系统稳定性
# CONFIG_UART_0_NRF_TX_BUFFER_SIZE=64
# CONFIG_MAIN_STACK_SIZE=640

# 使用内部低速晶振
CONFIG_CLOCK_CONTROL_NRF_K32SRC_RC=y
CONFIG_BT_RX_STACK_SIZE=2048
# CONFIG_FLASH_SIZE=512
# CONFIG_SRAM_SIZE=128
# CONFIG_MINIMAL_LIBC_OPTIMIZE_STRING_FOR_SIZE=n
# CONFIG_BT_HCI_TX_STACK_SIZE=2048
# CONFIG_DEBUG_THREAD_INFO=y
# CONFIG_DEBUG_OPTIMIZATIONS=y
```

## src/main.c
```c
/****
 * 
 * 
 * */
#include <zephyr.h>
#include "mybluetooth.h"
#include "myuart.h"
#include "uart_profile.h"

static K_SEM_DEFINE(ble_init_ok, 0, 1);



void main(void)
{
	int err;
	
	NRFX_DELAY_US(1000000);
	uart_init();

	err = bt_enable(NULL);
	if (err){
		printk("ble init faild\r\n");
	}
	/* 发送初始化成功的消息 */
	k_sem_give(&ble_init_ok);
	printk("ble init success!\r\n");
	ble_had_been_inited = 1;
	bt_advertising_start();
	
	while (1){
		printk("hello world\r\n");
		NRFX_DELAY_US(2000000);
	}
}
```

## inc/mybluetooth.h
```c
#ifndef __MYBLUETOOTH_H
#define __MYBLUETOOTH_H

#include <drivers/uart.h>
#include <bluetooth/bluetooth.h>

#define DEVICE_NAME CONFIG_BT_DEVICE_NAME
#define DEVICE_NAME_LEN (sizeof(DEVICE_NAME) - 1)

extern uint8_t ble_had_been_inited;

void bt_advertising_start(void);

#endif
```

## inc/myuart.h
```c
#ifndef __MYUART_H
#define __MYUART_H

#include <drivers/uart.h>


extern const struct device *uart;

int uart_init(void);


#endif
```

## src/mybluetooth.c
```c
#include "mybluetooth.h"
#include "uart_profile.h"

uint8_t ble_had_been_inited = 0;
/* 广播发送的信息 */
static const struct bt_data ad[] = {
	BT_DATA_BYTES(BT_DATA_FLAGS, (BT_LE_AD_GENERAL | BT_LE_AD_NO_BREDR)),
	BT_DATA(BT_DATA_NAME_COMPLETE, DEVICE_NAME, DEVICE_NAME_LEN),
}; 

/* 对方扫描回应的信息 */
static const struct bt_data sd[] = {
	BT_DATA_BYTES(BT_DATA_UUID128_ALL, UART_TP_UUID_VAL),
};


void bt_advertising_start(void){
	int err;
	/* Start advertising */
	err = bt_le_adv_start(BT_LE_ADV_CONN, ad, ARRAY_SIZE(ad),
			      sd, ARRAY_SIZE(sd));
    if (err) {
		printk("Advertising failed to start (err %d)\r\n", err);
		return;
	}
	printk("Advertising started!\r\n");
}
```

## src/myconn.c
```c
#include "myconn.h"
#include "myuart.h"
#include <bluetooth/conn.h>

static struct bt_conn *current_conn;
static struct bt_conn *auth_conn;

BT_CONN_CB_DEFINE(conn_callbacks) = {
	.connected    = connected,
	.disconnected = disconnected,
};


void connected(struct bt_conn *conn, uint8_t err)
{

	if (err) {
		printk("Connection failed (err %u)", err);
		return;
	}

	printk("Connected!!\r\n");

	current_conn = bt_conn_ref(conn);
}


void disconnected(struct bt_conn *conn, uint8_t reason)
{

	printk("Disconnected (reason %u)\r\n", reason);

	if (auth_conn) {
		bt_conn_unref(auth_conn);
		auth_conn = NULL;
	}

	if (current_conn) {
		bt_conn_unref(current_conn);
		current_conn = NULL;
	}
}
```

## src/myuart.c
```c
#include "myuart.h"

/* 串口设备 */
const struct device *uart;

/**
 * @breif: 串口回调函数，目前没用
 * @param
 */
static void uart_cb(const struct device *dev, struct uart_event *evt, void *user_data){

}


/**
 * @breif: 串口初始化
 */
int uart_init(void){
	int err;
	static struct uart_data_t rx;

	/* 初始化串口设备 */
	uart = device_get_binding(DT_LABEL(DT_NODELABEL(uart0)));
	if (!uart) {
		return -ENXIO;
	}

	/* 设置串口回调函数 */
	err = uart_callback_set(uart, uart_cb, NULL);
	if (err) {
		return err;
	}

	/* 初始化串口接收 */
	return uart_rx_enable(uart, rx.data, sizeof(rx.data),
			      UART_RX_TIMEOUT);
}


/**
 * @breif: 重定向printk函数，让printk打印向串口
 */
int arch_printk_char_out(int c)
{

	uart_poll_out(uart, (unsigned char)c);
	/* do nothing */
	return c;
}
```
